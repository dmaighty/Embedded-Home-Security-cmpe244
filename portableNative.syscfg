/**
 * @cliArgs --board "/ti/boards/MSP_EXP432P401R" --product "simplelink_msp432p4_sdk@3.40.01.02"
 * @versions {"tool":"1.10.0+2163"}
 */
const BOOSTXL_BASSENSORS = scripting.addHardware("/ti/boards/boosterpacks/BOOSTXL-BASSENSORS");

/**
 * Import the modules used in this configuration.
 */
const GPIO  = scripting.addModule("/ti/drivers/GPIO");
const GPIO1 = GPIO.addInstance();
const GPIO2 = GPIO.addInstance();
const GPIO3 = GPIO.addInstance();
const GPIO4 = GPIO.addInstance();
const GPIO5 = GPIO.addInstance();
const GPIO6 = GPIO.addInstance();
const GPIO7 = GPIO.addInstance();
const RTOS  = scripting.addModule("/ti/drivers/RTOS");
const UART  = scripting.addModule("/ti/drivers/UART");
const UART1 = UART.addInstance();

/**
 * Write custom configuration values to the imported modules.
 */
GPIO1.$hardware = system.deviceData.board.components.LED1_RED;
GPIO1.$name     = "CONFIG_GPIO_LED_0";

GPIO2.$hardware = system.deviceData.board.components.S2;
GPIO2.$name     = "CONFIG_GPIO_S2";

GPIO3.$name     = "CONFIG_GPIO_TMP116_EN";
GPIO3.$hardware = BOOSTXL_BASSENSORS.components.TMP116.subComponents.POWER;

GPIO4.$hardware = system.deviceData.board.components.LED2_GREEN;
GPIO4.$name     = "CONFIG_GPIO_LED_GREEN";

GPIO5.$name     = "CONFIG_GPIO_LED_BLUE";
GPIO5.$hardware = system.deviceData.board.components.LED2_BLUE;

GPIO6.$hardware = system.deviceData.board.components.S1;
GPIO6.$name     = "CONFIG_GPIO_S1";

GPIO7.$name           = "CONFIG_GPIO_LED_RED";
GPIO7.$hardware       = system.deviceData.board.components.LED2_RED;
GPIO7.gpioPin.$assign = "ball.16";

const Power                   = scripting.addModule("/ti/drivers/Power", {}, false);
Power.performanceLevel3.$name = "ti_drivers_power_PowerMSP432PerfLevels0";
Power.performanceLevel2.$name = "ti_drivers_power_PowerMSP432PerfLevels1";
Power.performanceLevel1.$name = "ti_drivers_power_PowerMSP432PerfLevels2";
Power.performanceLevel0.$name = "ti_drivers_power_PowerMSP432PerfLevels3";

RTOS.name = "FreeRTOS";

UART1.$name     = "CONFIG_UART_0";
UART1.$hardware = system.deviceData.board.components.XDS110UART;

/**
 * Pinmux solution for unlocked pins/peripherals. This ensures that minor changes to the automatic solver in a future
 * version of the tool will not impact the pinmux you originally saw.  These lines can be completely deleted in order to
 * re-solve from scratch.
 */
GPIO1.gpioPin.$suggestSolution    = "ball.4";
GPIO2.gpioPin.$suggestSolution    = "ball.8";
GPIO3.gpioPin.$suggestSolution    = "boosterpack.28";
GPIO4.gpioPin.$suggestSolution    = "ball.17";
GPIO5.gpioPin.$suggestSolution    = "ball.18";
GPIO6.gpioPin.$suggestSolution    = "ball.5";
UART1.uart.$suggestSolution       = "EUSCI_A0";
UART1.uart.txPin.$suggestSolution = "ball.7";
UART1.uart.rxPin.$suggestSolution = "ball.6";
